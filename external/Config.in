## external/configs/espressobin_defconfig
```kconfig
BR2_aarch64=y
BR2_TOOLCHAIN_BUILDROOT_GLIBC=y
BR2_KERNEL_HEADERS_4_11=y
BR2_BINUTILS_VERSION_2_28_X=y
BR2_TOOLCHAIN_BUILDROOT_CXX=y
BR2_TARGET_GENERIC_ROOT_PASSWD="root"
BR2_LINUX_KERNEL=y
BR2_LINUX_KERNEL_USE_ARCH_DEFAULT_CONFIG=y
BR2_LINUX_KERNEL_DTS_SUPPORT=y
BR2_LINUX_KERNEL_INTREE_DTS_NAME="marvell/armada-3720-espressobin"
BR2_LINUX_KERNEL_INSTALL_TARGET=y
```

## external/configs/skeleton_defconfig
```kconfig
BR2_x86_64=y
BR2_x86_corei7=y
BR2_TOOLCHAIN_BUILDROOT_MUSL=y
BR2_BINUTILS_VERSION_2_32_X=y
BR2_GCC_VERSION_9_X=y
BR2_TARGET_GENERIC_ROOT_PASSWD="root"
BR2_SYSTEM_DHCP="eth0"
BR2_LINUX_KERNEL=y
BR2_LINUX_KERNEL_USE_ARCH_DEFAULT_CONFIG=y
BR2_LINUX_KERNEL_XZ=y
BR2_LINUX_KERNEL_NEEDS_HOST_OPENSSL=y
BR2_PACKAGE_BUSYBOX_CONFIG="$(BR2_EXTERNAL_SKELETON_X86_64_PATH)/configs/busybox.config"
BR2_PACKAGE_DROPBEAR=y
BR2_TARGET_ROOTFS_CPIO_XZ=y
BR2_TARGET_ROOTFS_INITRAMFS=y
# BR2_TARGET_ROOTFS_TAR is not set
BR2_PACKAGE_HOST_JQ=y
```

## external/package/Config.in
```kconfig
source "$BR2_EXTERNAL/package/buildroot/Config.in"
source "$BR2_EXTERNAL/package/static-compilers/Config.in"
```

## external/package/buildroot/Config.in
```kconfig
config BR2_PACKAGE_BUILDROOT
	bool "buildroot 2016.08"
	help
		This is buildroot itself!
```

## external/package/static-compilers/Config.in
```kconfig
config BR2_PACKAGE_STATIC_COMPILERS
	depends on BR2_x86_64
	bool "Static compilers from Aboriginal Linux (landley.net)"
```
